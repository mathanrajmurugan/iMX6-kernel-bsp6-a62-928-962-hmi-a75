

#include "imx6qdl-seco_SBC_A62_expansion_J8.dtsi"



// Follow code generated automatically







&uart4 {
	pinctrl-0     = <&pinctrl_j8_port4_1>;
	fsl,uart-has-rtscts;
	status        = "okay";
};




&usdhc1 {
	status = "okay";
};




&uart1 {
	status = "okay";
};




&uart5 {
	pinctrl-0     = <&pinctrl_j8_port5_2>;
	status        = "okay";
};

